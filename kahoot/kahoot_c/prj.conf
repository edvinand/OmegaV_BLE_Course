## prj.conf
```kconfig
#
# Copyright (c) 2018 Nordic Semiconductor
#
# SPDX-License-Identifier: LicenseRef-Nordic-5-Clause
#


# Configure logger
CONFIG_LOG=y
CONFIG_USE_SEGGER_RTT=n
CONFIG_LOG_BACKEND_UART=y
CONFIG_LOG_DEFAULT_LEVEL=3
CONFIG_LOG_PROCESS_THREAD_STACK_SIZE=32768
CONFIG_LOG_BUFFER_SIZE=16384

# Enable the BLE stack with GATT Client configuration
CONFIG_BT=y
CONFIG_BT_CENTRAL=y
CONFIG_BT_SMP=y
CONFIG_BT_GATT_CLIENT=y

# Enable the BLE modules from NCS
CONFIG_BT_NUS_CLIENT=y
CONFIG_BT_SCAN=y
CONFIG_BT_SCAN_FILTER_ENABLE=y
CONFIG_BT_SCAN_UUID_CNT=1
CONFIG_BT_GATT_DM=y
CONFIG_HEAP_MEM_POOL_SIZE=2048

# This example requires more workqueue stack
CONFIG_SYSTEM_WORKQUEUE_STACK_SIZE=2048

# Enable bonding
CONFIG_BT_SETTINGS=y
CONFIG_FLASH=y
CONFIG_FLASH_PAGE_LAYOUT=y
CONFIG_FLASH_MAP=y
CONFIG_NVS=y
CONFIG_SETTINGS=y

# Config logger
# CONFIG_LOG=y
# CONFIG_USE_SEGGER_RTT=y
# CONFIG_LOG_BACKEND_RTT=y
# CONFIG_LOG_BACKEND_UART=n

# Configure buttons and LEDs.
CONFIG_GPIO=y
CONFIG_DK_LIBRARY=y

CONFIG_ASSERT=y
```

## src/main.c
```c
/*
 * Copyright (c) 2018 Nordic Semiconductor ASA
 *
 * SPDX-License-Identifier: LicenseRef-Nordic-5-Clause
 */

/** @file
 *  @brief Nordic UART Service Client sample
 */

#include <errno.h>
#include <zephyr/kernel.h>
#include <zephyr/device.h>
#include <zephyr/devicetree.h>
#include <zephyr/sys/byteorder.h>
#include <zephyr/sys/printk.h>

#include <zephyr/bluetooth/bluetooth.h>
#include <zephyr/bluetooth/hci.h>
#include <zephyr/bluetooth/conn.h>
#include <zephyr/bluetooth/uuid.h>
#include <zephyr/bluetooth/gatt.h>

#include <bluetooth/services/nus.h>
#include <bluetooth/services/nus_client.h>
#include <bluetooth/gatt_dm.h>
#include <bluetooth/scan.h>

#include <zephyr/settings/settings.h>

#include <zephyr/drivers/uart.h>

#include <zephyr/logging/log.h>
#include <dk_buttons_and_leds.h>

#define RUN_STATUS_LED DK_LED1

#define NUMBER_OF_QUESTIONS 10
#define MAX_PARTICIPANTS    25


uint8_t registered_answers[MAX_PARTICIPANTS][NUMBER_OF_QUESTIONS];
uint8_t correct_answers[NUMBER_OF_QUESTIONS] = {'A', 'B', 'C', 'D', 'A', 'B', 'C', 'D', 'A', 'B'};
uint8_t participant_names[MAX_PARTICIPANTS][5];
uint8_t m_question_number = 0;
uint8_t m_registered_participants = 0;

#define BT_UUID_REMOTE_SERV_VAL \
    BT_UUID_128_ENCODE(0xe9ea0001, 0xe19b, 0x482d, 0x9293, 0xc7907585fc48)

#define BT_UUID_REMOTE_SERVICE          BT_UUID_DECLARE_128(BT_UUID_REMOTE_SERV_VAL)

#define LOG_MODULE_NAME central_uart
LOG_MODULE_REGISTER(LOG_MODULE_NAME);

/* UART payload buffer element size. */
#define UART_BUF_SIZE 20

#define KEY_PASSKEY_ACCEPT DK_BTN1_MSK
#define KEY_PASSKEY_REJECT DK_BTN2_MSK

#define NUS_WRITE_TIMEOUT K_MSEC(150)
#define UART_WAIT_FOR_BUF_DELAY K_MSEC(50)
#define UART_RX_TIMEOUT 50

static const struct device *uart = DEVICE_DT_GET(DT_NODELABEL(uart0));
// static struct k_work_delayable uart_work;

K_SEM_DEFINE(nus_write_sem, 0, 1);

struct uart_data_t {
	void *fifo_reserved;
	uint8_t  data[UART_BUF_SIZE];
	uint16_t len;
};

static K_FIFO_DEFINE(fifo_uart_tx_data);
static K_FIFO_DEFINE(fifo_uart_rx_data);

static struct bt_conn *default_conn;
static struct bt_nus_client nus_client;

static void ble_data_sent(struct bt_nus_client *nus, uint8_t err,
					const uint8_t *const data, uint16_t len)
{
	ARG_UNUSED(nus);

	struct uart_data_t *buf;

	/* Retrieve buffer context. */
	buf = CONTAINER_OF(data, struct uart_data_t, data);
	k_free(buf);

	k_sem_give(&nus_write_sem);

	if (err) {
		LOG_WRN("ATT error code: 0x%02X", err);
	}
}

static uint8_t ble_data_received(struct bt_nus_client *nus,
						const uint8_t *data, uint16_t len)
{
	ARG_UNUSED(nus);

	int err;

	for (uint16_t pos = 0; pos != len;) {
		struct uart_data_t *tx = k_malloc(sizeof(*tx));

		if (!tx) {
			LOG_WRN("Not able to allocate UART send data buffer");
			return BT_GATT_ITER_CONTINUE;
		}

		/* Keep the last byte of TX buffer for potential LF char. */
		size_t tx_data_size = sizeof(tx->data) - 1;

		if ((len - pos) > tx_data_size) {
			tx->len = tx_data_size;
		} else {
			tx->len = (len - pos);
		}

		memcpy(tx->data, &data[pos], tx->len);

		pos += tx->len;

		/* Append the LF character when the CR character triggered
		 * transmission from the peer.
		 */
		if ((pos == len) && (data[len - 1] == '\r')) {
			tx->data[tx->len] = '\n';
			tx->len++;
		}

		err = uart_tx(uart, tx->data, tx->len, SYS_FOREVER_MS);
		if (err) {
			k_fifo_put(&fifo_uart_tx_data, tx);
		}
	}

	return BT_GATT_ITER_CONTINUE;
}

// static void uart_cb(const struct device *dev, struct uart_event *evt, void *user_data)
// {
// 	ARG_UNUSED(dev);

// 	static size_t aborted_len;
// 	struct uart_data_t *buf;
// 	static uint8_t *aborted_buf;
// 	static bool disable_req;

// 	switch (evt->type) {
// 	case UART_TX_DONE:
// 		LOG_DBG("UART_TX_DONE");
// 		if ((evt->data.tx.len == 0) ||
// 		    (!evt->data.tx.buf)) {
// 			return;
// 		}

// 		if (aborted_buf) {
// 			buf = CONTAINER_OF(aborted_buf, struct uart_data_t,
// 					   data);
// 			aborted_buf = NULL;
// 			aborted_len = 0;
// 		} else {
// 			buf = CONTAINER_OF(evt->data.tx.buf,
// 					   struct uart_data_t,
// 					   data);
// 		}

// 		k_free(buf);

// 		buf = k_fifo_get(&fifo_uart_tx_data, K_NO_WAIT);
// 		if (!buf) {
// 			return;
// 		}

// 		if (uart_tx(uart, buf->data, buf->len, SYS_FOREVER_MS)) {
// 			LOG_WRN("Failed to send data over UART");
// 		}

// 		break;

// 	case UART_RX_RDY:
// 		LOG_DBG("UART_RX_RDY");
// 		buf = CONTAINER_OF(evt->data.rx.buf, struct uart_data_t, data);
// 		buf->len += evt->data.rx.len;

// 		if (disable_req) {
// 			return;
// 		}

// 		if ((evt->data.rx.buf[buf->len - 1] == '\n') ||
// 		    (evt->data.rx.buf[buf->len - 1] == '\r')) {
// 			disable_req = true;
// 			uart_rx_disable(uart);
// 		}

// 		break;

// 	case UART_RX_DISABLED:
// 		LOG_DBG("UART_RX_DISABLED");
// 		disable_req = false;

// 		buf = k_malloc(sizeof(*buf));
// 		if (buf) {
// 			buf->len = 0;
// 		} else {
// 			LOG_WRN("Not able to allocate UART receive buffer");
// 			k_work_reschedule(&uart_work, UART_WAIT_FOR_BUF_DELAY);
// 			return;
// 		}

// 		uart_rx_enable(uart, buf->data, sizeof(buf->data),
// 			       UART_RX_TIMEOUT);

// 		break;

// 	case UART_RX_BUF_REQUEST:
// 		LOG_DBG("UART_RX_BUF_REQUEST");
// 		buf = k_malloc(sizeof(*buf));
// 		if (buf) {
// 			buf->len = 0;
// 			uart_rx_buf_rsp(uart, buf->data, sizeof(buf->data));
// 		} else {
// 			LOG_WRN("Not able to allocate UART receive buffer");
// 		}

// 		break;

// 	case UART_RX_BUF_RELEASED:
// 		LOG_DBG("UART_RX_BUF_RELEASED");
// 		buf = CONTAINER_OF(evt->data.rx_buf.buf, struct uart_data_t,
// 				   data);

// 		if (buf->len > 0) {
// 			k_fifo_put(&fifo_uart_rx_data, buf);
// 		} else {
// 			k_free(buf);
// 		}

// 		break;

// 	case UART_TX_ABORTED:
// 		LOG_DBG("UART_TX_ABORTED");
// 		if (!aborted_buf) {
// 			aborted_buf = (uint8_t *)evt->data.tx.buf;
// 		}

// 		aborted_len += evt->data.tx.len;
// 		buf = CONTAINER_OF(aborted_buf, struct uart_data_t,
// 				   data);

// 		uart_tx(uart, &buf->data[aborted_len],
// 			buf->len - aborted_len, SYS_FOREVER_MS);

// 		break;

// 	default:
// 		break;
// 	}
// }

// static void uart_work_handler(struct k_work *item)
// {
// 	struct uart_data_t *buf;

// 	buf = k_malloc(sizeof(*buf));
// 	if (buf) {
// 		buf->len = 0;
// 	} else {
// 		LOG_WRN("Not able to allocate UART receive buffer");
// 		k_work_reschedule(&uart_work, UART_WAIT_FOR_BUF_DELAY);
// 		return;
// 	}

// 	uart_rx_enable(uart, buf->data, sizeof(buf->data), UART_RX_TIMEOUT);
// }

static int uart_init(void)
{
	// int err;
	// struct uart_data_t *rx;

	// if (!device_is_ready(uart)) {
	// 	LOG_ERR("UART device not ready");
	// 	return -ENODEV;
	// }

	// rx = k_malloc(sizeof(*rx));
	// if (rx) {
	// 	rx->len = 0;
	// } else {
	// 	return -ENOMEM;
	// }

	// k_work_init_delayable(&uart_work, uart_work_handler);

	// err = uart_callback_set(uart, uart_cb, NULL);
	// if (err) {
	// 	return err;
	// }

	// return uart_rx_enable(uart, rx->data, sizeof(rx->data),
	// 		      UART_RX_TIMEOUT);
    return 0;
}

static void discovery_complete(struct bt_gatt_dm *dm,
			       void *context)
{
	struct bt_nus_client *nus = context;
	LOG_INF("Service discovery completed");

	bt_gatt_dm_data_print(dm);

	bt_nus_handles_assign(dm, nus);
	bt_nus_subscribe_receive(nus);

	bt_gatt_dm_data_release(dm);
}

static void discovery_service_not_found(struct bt_conn *conn,
					void *context)
{
	LOG_INF("Service not found");
}

static void discovery_error(struct bt_conn *conn,
			    int err,
			    void *context)
{
	LOG_WRN("Error while discovering GATT database: (%d)", err);
}

struct bt_gatt_dm_cb discovery_cb = {
	.completed         = discovery_complete,
	.service_not_found = discovery_service_not_found,
	.error_found       = discovery_error,
};

static void gatt_discover(struct bt_conn *conn)
{
	int err;

	if (conn != default_conn) {
		return;
	}

	err = bt_gatt_dm_start(conn,
			       BT_UUID_NUS_SERVICE,
			       &discovery_cb,
			       &nus_client);
	if (err) {
		LOG_ERR("could not start the discovery procedure, error "
			"code: %d", err);
	}
}

static void exchange_func(struct bt_conn *conn, uint8_t err, struct bt_gatt_exchange_params *params)
{
	if (!err) {
		LOG_INF("MTU exchange done");
	} else {
		LOG_WRN("MTU exchange failed (err %" PRIu8 ")", err);
	}
}

static void connected(struct bt_conn *conn, uint8_t conn_err)
{
	char addr[BT_ADDR_LE_STR_LEN];
	int err;

	bt_addr_le_to_str(bt_conn_get_dst(conn), addr, sizeof(addr));

	if (conn_err) {
		LOG_INF("Failed to connect to %s (%d)", addr, conn_err);

		if (default_conn == conn) {
			bt_conn_unref(default_conn);
			default_conn = NULL;

			err = bt_scan_start(BT_SCAN_TYPE_SCAN_ACTIVE);
			if (err) {
				LOG_ERR("Scanning failed to start (err %d)",
					err);
			}
		}

		return;
	}

	LOG_INF("Connected: %s", addr);

	static struct bt_gatt_exchange_params exchange_params;

	exchange_params.func = exchange_func;
	err = bt_gatt_exchange_mtu(conn, &exchange_params);
	if (err) {
		LOG_WRN("MTU exchange failed (err %d)", err);
	}

	err = bt_conn_set_security(conn, BT_SECURITY_L2);
	if (err) {
		LOG_WRN("Failed to set security: %d", err);

		gatt_discover(conn);
	}

	err = bt_scan_stop();
	if ((!err) && (err != -EALREADY)) {
		LOG_ERR("Stop LE scan failed (err %d)", err);
	}
}

static void disconnected(struct bt_conn *conn, uint8_t reason)
{
	char addr[BT_ADDR_LE_STR_LEN];
	int err;

	bt_addr_le_to_str(bt_conn_get_dst(conn), addr, sizeof(addr));

	LOG_INF("Disconnected: %s (reason %u)", addr, reason);

	if (default_conn != conn) {
		return;
	}

	bt_conn_unref(default_conn);
	default_conn = NULL;

	err = bt_scan_start(BT_SCAN_TYPE_SCAN_ACTIVE);
	if (err) {
		LOG_ERR("Scanning failed to start (err %d)",
			err);
	}
}

static void security_changed(struct bt_conn *conn, bt_security_t level,
			     enum bt_security_err err)
{
	char addr[BT_ADDR_LE_STR_LEN];

	bt_addr_le_to_str(bt_conn_get_dst(conn), addr, sizeof(addr));

	if (!err) {
		LOG_INF("Security changed: %s level %u", addr, level);
	} else {
		LOG_WRN("Security failed: %s level %u err %d", addr,
			level, err);
	}

	gatt_discover(conn);
}

BT_CONN_CB_DEFINE(conn_callbacks) = {
	.connected = connected,
	.disconnected = disconnected,
	.security_changed = security_changed
};

int register_participant(uint8_t * p_name)
{
    for (uint8_t i=0; i<m_registered_participants; i++)
    {
        if ((participant_names[i][0] == p_name[0]) &&
            (participant_names[i][1] == p_name[1]) &&
            (participant_names[i][2] == p_name[2]) &&
            (participant_names[i][3] == p_name[3])) {
                return i;
            }
    }
    participant_names[m_registered_participants][0] = p_name[0];
    participant_names[m_registered_participants][1] = p_name[1];
    participant_names[m_registered_participants][2] = p_name[2];
    participant_names[m_registered_participants][3] = p_name[3];
    m_registered_participants++;
    return m_registered_participants-1;
}

static void scan_filter_match(struct bt_scan_device_info *device_info,
			      struct bt_scan_filter_match *filter_match,
			      bool connectable)
{
    // uint8_t registered_answers[MAX_PARTICIPANTS][NUMBER_OF_QUESTIONS];
    // uint8_t correct_answers[MAX_PARTICIPANTS][NUMBER_OF_QUESTIONS];
    // uint8_t participant_names[MAX_PARTICIPANTS][4];
    int peer_nr = register_participant(&(device_info->adv_data->data[21]));
    if ((peer_nr < 0)||(peer_nr >=MAX_PARTICIPANTS)) {
        return;
    }
    registered_answers[peer_nr][m_question_number] = device_info->adv_data->data[20];
	
    
    //char addr[BT_ADDR_LE_STR_LEN];

	//bt_addr_le_to_str(device_info->recv_info->addr, addr, sizeof(addr));

	// LOG_INF("Filters matched. Address: %s connectable: %d",
	// 	addr, connectable);
    // LOG_INF("FM - len: %d", device_info->adv_data->len);
    // LOG_INF("%02x:%02x:%02x:%02x:%02x", device_info->adv_data->data[0],
    //                                     device_info->adv_data->data[1],
    //                                     device_info->adv_data->data[2],
    //                                     device_info->adv_data->data[3],
    //                                     device_info->adv_data->data[4]);

    // LOG_INF("%02x:%02x:%02x:%02x:%02x", device_info->adv_data->data[5],
    //                                     device_info->adv_data->data[6],
    //                                     device_info->adv_data->data[7],
    //                                     device_info->adv_data->data[8],
    //                                     device_info->adv_data->data[9]);

    // LOG_INF("%02x:%02x:%02x:%02x:%02x", device_info->adv_data->data[10],
    //                                     device_info->adv_data->data[11],
    //                                     device_info->adv_data->data[12],
    //                                     device_info->adv_data->data[13],
    //                                     device_info->adv_data->data[14]);
    
    // LOG_INF("%02x:%02x:%02x:%02x:%02x", device_info->adv_data->data[15],
    //                                     device_info->adv_data->data[16],
    //                                     device_info->adv_data->data[17],
    //                                     device_info->adv_data->data[18],
    //                                     device_info->adv_data->data[19]);

    // LOG_INF("%02x:%02x:%02x:%02x:%02x", device_info->adv_data->data[20],
    //                                     device_info->adv_data->data[21],
    //                                     device_info->adv_data->data[22],
    //                                     device_info->adv_data->data[23],
    //                                     device_info->adv_data->data[24]);

    // LOG_INF("%02x:%02x:%02x:%02x:%02x", device_info->adv_data->data[25],
    //                                     device_info->adv_data->data[26],
    //                                     device_info->adv_data->data[27],
    //                                     device_info->adv_data->data[28],
    //                                     device_info->adv_data->data[29]);


}

static void scan_connecting_error(struct bt_scan_device_info *device_info)
{
	LOG_WRN("Connecting failed");
}

static void scan_connecting(struct bt_scan_device_info *device_info,
			    struct bt_conn *conn)
{
	default_conn = bt_conn_ref(conn);
}

static int nus_client_init(void)
{
	int err;
	struct bt_nus_client_init_param init = {
		.cb = {
			.received = ble_data_received,
			.sent = ble_data_sent,
		}
	};

	err = bt_nus_client_init(&nus_client, &init);
	if (err) {
		LOG_ERR("NUS Client initialization failed (err %d)", err);
		return err;
	}

	LOG_INF("NUS Client module initialized");
	return err;
}

BT_SCAN_CB_INIT(scan_cb, scan_filter_match, NULL,
		scan_connecting_error, scan_connecting);

static int scan_init(void)
{
	int err;
	struct bt_scan_init_param scan_init = {
		.connect_if_match = 0,
	};

	bt_scan_init(&scan_init);
	bt_scan_cb_register(&scan_cb);

	err = bt_scan_filter_add(BT_SCAN_FILTER_TYPE_UUID, BT_UUID_REMOTE_SERVICE);
	if (err) {
		LOG_ERR("Scanning filters cannot be set (err %d)", err);
		return err;
	}

	err = bt_scan_filter_enable(BT_SCAN_UUID_FILTER, false);
	if (err) {
		LOG_ERR("Filters cannot be turned on (err %d)", err);
		return err;
	}

	LOG_INF("Scan module initialized");
	return err;
}


static void auth_cancel(struct bt_conn *conn)
{
	char addr[BT_ADDR_LE_STR_LEN];

	bt_addr_le_to_str(bt_conn_get_dst(conn), addr, sizeof(addr));

	LOG_INF("Pairing cancelled: %s", addr);
}


static void pairing_complete(struct bt_conn *conn, bool bonded)
{
	char addr[BT_ADDR_LE_STR_LEN];

	bt_addr_le_to_str(bt_conn_get_dst(conn), addr, sizeof(addr));

	LOG_INF("Pairing completed: %s, bonded: %d", addr, bonded);
}


static void pairing_failed(struct bt_conn *conn, enum bt_security_err reason)
{
	char addr[BT_ADDR_LE_STR_LEN];

	bt_addr_le_to_str(bt_conn_get_dst(conn), addr, sizeof(addr));

	LOG_WRN("Pairing failed conn: %s, reason %d", addr, reason);
}

static struct bt_conn_auth_cb conn_auth_callbacks = {
	.cancel = auth_cancel,
};

static struct bt_conn_auth_info_cb conn_auth_info_callbacks = {
	.pairing_complete = pairing_complete,
	.pairing_failed = pairing_failed
};

    // uint8_t registered_answers[MAX_PARTICIPANTS][NUMBER_OF_QUESTIONS];
    // uint8_t correct_answers[MAX_PARTICIPANTS][NUMBER_OF_QUESTIONS];
    // uint8_t participant_names[MAX_PARTICIPANTS][4];

void print_participants(void)
{
    for (uint8_t i=0; i<m_registered_participants; i++) {
        LOG_INF("P%02d: %c%c%c%c", i,
                                participant_names[i][0],
                                participant_names[i][1],
                                participant_names[i][2],
                                participant_names[i][3]);
    }
}

void print_registered_answers(void)
{
    // for(int i=0; i<MAX_PARTICIPANTS; i++)
    // {
    //     for (int j=0; j<NUMBER_OF_QUESTIONS; j++)
    //     {
    //         registered_answers[i][j] = 'D';
    //     }
    // }
    LOG_PRINTK("-------------------------------------------\n");
    for (uint8_t i=0; i<m_registered_participants; i++) {
        LOG_PRINTK("| %c%c%c%c: ", participant_names[i][0],
                                   participant_names[i][1],
                                   participant_names[i][2],
                                   participant_names[i][3]);
        for (uint8_t j=0; j<NUMBER_OF_QUESTIONS;j++){
            LOG_PRINTK(" %c :", registered_answers[i][j]);
        }
        LOG_PRINTK("\n");
    }
    LOG_PRINTK("-------------------------------------------\n");
}

void calculate_score(void)
{
    for (uint8_t i=0; i<m_registered_participants; i++) {
        participant_names[i][4] = 0;
        for (uint8_t j=0; j<NUMBER_OF_QUESTIONS; j++) {
            if (registered_answers[i][j] == correct_answers[j]) {
                participant_names[i][4] += 1;
            }
        }
    }
}

void print_score(void)
{
    for (uint8_t i=0; i<m_registered_participants; i++) {
        LOG_INF("%c%c%c%c: %d points!", participant_names[i][0],
                                        participant_names[i][1],
                                        participant_names[i][2],
                                        participant_names[i][3],
                                        participant_names[i][4]);
    }
}

void button_handler(uint32_t button_state, uint32_t has_changed)
{
	int button_pressed = 0;
	if (has_changed & button_state)
	{
		switch (has_changed)
		{
			case DK_BTN1_MSK:
				button_pressed = 1;
				break;
			case DK_BTN2_MSK:
				button_pressed = 2;
				break;
			case DK_BTN3_MSK:
				button_pressed = 3;
                print_registered_answers();
				break;
			case DK_BTN4_MSK:
				button_pressed = 4;
                //print_participants();
                calculate_score();
                print_score();
				break;
			default:
				break;
		}
        
        if ((button_pressed == 1) && (m_question_number < NUMBER_OF_QUESTIONS-1)) {
            m_question_number++;
        }
        else if((button_pressed == 2) && (m_question_number >0)) {
            m_question_number--;
        }
        LOG_INF("Button %d pressed, question: %d", button_pressed, (m_question_number+1));
        
    }
}

/* Configurations */
static void configure_dk_buttons_and_leds(void)
{
    int err;
    err = dk_leds_init();
    if (err) {
        LOG_ERR("Couldn't init LEDs (err %d)", err);
    }
    err = dk_buttons_init(button_handler);
    if (err) {
        LOG_ERR("Couldn't init buttons (err %d)", err);
    }
}

void main(void)
{
	int err;
    int blink_status = 0;

    configure_dk_buttons_and_leds();

	err = bt_conn_auth_cb_register(&conn_auth_callbacks);
	if (err) {
		LOG_ERR("Failed to register authorization callbacks.");
		return;
	}

	err = bt_conn_auth_info_cb_register(&conn_auth_info_callbacks);
	if (err) {
		printk("Failed to register authorization info callbacks.\n");
		return;
	}

	err = bt_enable(NULL);
	if (err) {
		LOG_ERR("Bluetooth init failed (err %d)", err);
		return;
	}
	LOG_INF("Bluetooth initialized");

	if (IS_ENABLED(CONFIG_SETTINGS)) {
		settings_load();
	}

	int (*module_init[])(void) = {uart_init, scan_init, nus_client_init};
	for (size_t i = 0; i < ARRAY_SIZE(module_init); i++) {
		err = (*module_init[i])();
		if (err) {
			return;
		}
	}

	printk("Starting Bluetooth Central UART example\n");


	err = bt_scan_start(BT_SCAN_TYPE_SCAN_ACTIVE);
	if (err) {
		LOG_ERR("Scanning failed to start (err %d)", err);
		return;
	}

	LOG_INF("Scanning successfully started");

	for (;;) {
        dk_set_led(RUN_STATUS_LED, (blink_status++)%2);
        k_sleep(K_MSEC(1000));
	// 	/* Wait indefinitely for data to be sent over Bluetooth */
	// 	struct uart_data_t *buf = k_fifo_get(&fifo_uart_rx_data,
	// 					     K_FOREVER);

	// 	err = bt_nus_client_send(&nus_client, buf->data, buf->len);
	// 	if (err) {
	// 		LOG_WRN("Failed to send data over BLE connection"
	// 			"(err %d)", err);
	// 	}

	// 	err = k_sem_take(&nus_write_sem, NUS_WRITE_TIMEOUT);
	// 	if (err) {
	// 		LOG_WRN("NUS send timeout");
	// 	}
	 }
}
```
